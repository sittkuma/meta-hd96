## meta-hd96.thud/meta-hd96/conf/layer.conf
```bitbake
# We have a conf and classes directory, add to BBPATH
BBPATH .= ":${LAYERDIR}"

# We have recipes-* directories, add to BBFILES
BBFILES += "${LAYERDIR}/recipes-*/*/*.bb \
            ${LAYERDIR}/recipes-*/*/*.bbappend"

BBFILE_COLLECTIONS += "hd96"
BBFILE_PATTERN_hd96 = "^${LAYERDIR}/"
BBFILE_PRIORITY_hd96 = "10"
LAYERSERIES_COMPAT_hd96 = "thud"
```

## meta-hd96.thud/meta-hd96/conf/machine/sama5d27-hd96.conf
```bitbake
#@TYPE: Machine
#@Name: ARROW HD96 SD
#@DESCRIPTION: Machine configuration for Arrow's HD96 board

require conf/machine/include/sama5d2.inc

MACHINE_FEATURES = "apm alsa ext2 ext3 usbhost usbgadget touchscreen"
KERNEL_DEVICETREE = " \
		sama5d27_hd96.dtb \
		"

do_image_wic[depends] += "u-boot-at91:do_deploy"
IMAGE_FSTYPES += " tar.gz wic"
WKS_FILE = "sdimage-bootpart-swap.wks"

IMAGE_BOOT_FILES = "BOOT.BIN u-boot.bin uboot.env sama5d27_hd96.itb \
                    "

UBOOT_MACHINE ?= "sama5d27_hd96_mmc1_defconfig"
UBOOT_ENTRYPOINT = "0x20008000"
UBOOT_LOADADDRESS = "0x20008000"
UBOOT_ENV_SIZE = "0x4000"

AT91BOOTSTRAP_MACHINE ?= "sama5d27_hd96"

# Needed for FIT
MACHINE_ESSENTIAL_EXTRA_RDEPENDS = " dt-overlay-at91"
```
